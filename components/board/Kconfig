## components/board/Kconfig
```kconfig
menu "P1S Heat Controller Board"

config P1S_RELAY_ACTIVE_LOW
    bool "Relay channels are active low"
    default n
    help
        Enable for relay boards that energize when the control input is low.
        The default is active high: LOW is off and HIGH is on. Both channels
        initialize at the inactive level before their output drivers are enabled.

endmenu
```

## components/firmware_update/Kconfig.projbuild
```kconfig
menu "P1S Firmware Updates"
config P1S_RELEASE_REPOSITORY
    string "Public firmware release repository"
    default "ahmaddawod12/P1S-HeatControl"
    help
        Public GitHub owner/repository containing signed firmware assets.
        The controller never needs a GitHub access token.
endmenu
```

## components/printer_control/Kconfig.projbuild
```kconfig
menu "P1S printer integration"
config P1S_PRINTER_AUTO_RESUME
    bool "Enable qualified P1S preheat and Resume"
    default n
    help
        Enable only after the startup pause before all extrusion and native
        Resume deadline have passed the documented compatibility qualification.
        Monitoring and configuration work without this option.
endmenu
```

## components/wifi_manager/Kconfig.projbuild
```kconfig
menu "P1S Heat Controller"

config P1S_WIFI_SSID
    string "Wi-Fi SSID"
    default ""
    help
        Name of the network the controller joins at boot. The controller is
        station-only, so a board built without this never reaches the network
        and its web UI stays unreachable. Heat regulation is unaffected.

        Supply this through the gitignored sdkconfig.secret, never through
        sdkconfig.defaults, which is tracked in Git.

config P1S_WIFI_PASSWORD
    string "Wi-Fi password"
    default ""
    help
        WPA2 passphrase for P1S_WIFI_SSID: either 8 to 63 bytes, or empty for
        an open network. Any other length is rejected at startup.

        Supply this through the gitignored sdkconfig.secret, never through
        sdkconfig.defaults, which is tracked in Git.

endmenu
```

## test_apps/sensor_smoke/sdkconfig.defaults
```kconfig
CONFIG_IDF_TARGET="esp32"
CONFIG_ESP_CONSOLE_UART_DEFAULT=y
CONFIG_ESPTOOLPY_FLASHSIZE_4MB=y
```
